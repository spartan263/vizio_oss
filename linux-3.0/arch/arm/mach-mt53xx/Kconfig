## linux-3.0/arch/arm/mach-mt53xx/Kconfig
```kconfig
# arch/arm/plat-mt53xx/Kconfig
#
# by lh.hsiao
#
# Licensed under GPLv2


if PLAT_MT53XX
# boot configurations
choice
	prompt "ARCH/MACH select"
default MACH_MT5396

config MACH_MT5368
	bool "MediaTek MT5368(Cortex-A9 single-core)"
	select CPU_V7
	select ARM_GIC
	select ARCH_MT5368
	select CACHE_L2X0
	select CACHE_PL310
	help
	  This enables support for MediaTek MT5368.

config MACH_MT5396
	bool "MediaTek MT5396(Cortex-A9 dual-core)"
	select CPU_V7
	select SMP 
	select ARM_GIC
	select ARCH_MT5396
	select NEED_PREPARE_CPUS_FOR_ONE
	select CACHE_L2X0
	select CACHE_PL310
	help
	  This enables support for MediaTek MT5396.

config MACH_MT5369
	bool "MediaTek MT5369(Cortex-A9 single-core)"
	select CPU_V7
	select ARM_GIC
	select ARCH_MT5396	       	# Share code with MT5396
	select MT53XX_UP_CHECK
	select CACHE_L2X0
	select CACHE_PL310
	help
	  This enables support for MediaTek MT5369.

config MACH_MT5389
	bool "MediaTek MT5389(Arm11)"
	select CPU_V6
	select CPU_32v6K
	select ARCH_MT5389
	select CACHE_L2X0
	select CACHE_PL310
	help
	  This enables support for MediaTek MT5389.

config MACH_MT5398
	bool "MediaTek MT5398(Cobra Cortex-A9 dual-core)"
	select CPU_V7
	select ARM_GIC
	select ARCH_MT5398
	select NEED_PREPARE_CPUS_FOR_ONE if SMP
	select MT53XX_UP_CHECK if !SMP
	help
	  This enables support for MediaTek MT5398.

config MACH_MT5880
	bool "MediaTek MT5880(Viper Cortex-A9)"
	select CPU_V7
	select ARM_GIC
	select ARCH_MT5880
	select NEED_PREPARE_CPUS_FOR_ONE if SMP
	select MT53XX_UP_CHECK if !SMP
	help
	  This enables support for MediaTek MT5398.
config MACH_MT5881
	bool "MediaTek MT5881(Arm11)"
	select CPU_V6
	select CPU_32v6K
	select ARCH_MT5881
	help
	  This enables support for MediaTek MT5881.

config MACH_MT5368_FPGA
	bool "MediaTek MT5368_FPGA(ARM11)"
	select CPU_V6
	select ARCH_MT5368
	select MT53_FPGA
	help
	  This enables support for MediaTek MT5368.

config MACH_MT5396_FPGA
	bool "MediaTek MT5396_FPGA(ARM11)"
	select CPU_V7
	select ARCH_MT5396
	select MT53_FPGA
	help
	  This enables support for MediaTek MT5396.
endchoice  

config ARCH_MT5368
	bool "MediaTek MT5368" if MACH_MT5368 || MACH_MT5368_FPGA
	default n
	select GENERIC_TIME
	select GENERIC_CLOCKEVENTS
	help
	  This enables support for MediaTek MT5368.

config ARCH_MT5396
	bool "MediaTek MT5396" if MACH_MT5396 || MACH_MT5396_FPGA
	default n
	select GENERIC_TIME
	select GENERIC_CLOCKEVENTS
	#select ARCH_USES_GETTIMEOFFSET
	help
	  This enables support for MediaTek MT5396.

config ARCH_MT5389
	bool "MediaTek MT5389" if MACH_MT5389
	default n
	select GENERIC_TIME
	select GENERIC_CLOCKEVENTS
	help
	  This enables support for MediaTek MT5389.

config ARCH_MT5398
	bool "MediaTek MT5398" if MACH_MT5398
	default n
	select GENERIC_TIME
	select GENERIC_CLOCKEVENTS
	select MT53XX_NATIVE_GPIO
	help
	  This enables support for MediaTek MT5398.

config ARCH_MT5880
	bool "MediaTek MT5880" if MACH_MT5880
	default n
	select GENERIC_TIME
	select GENERIC_CLOCKEVENTS
	select MT53XX_NATIVE_GPIO
	help
	  This enables support for MediaTek MT5880.
config ARCH_MT5881
	bool "MediaTek MT5880" if MACH_MT5881
	default n
	select GENERIC_TIME
	select GENERIC_CLOCKEVENTS
	help
	  This enables support for MediaTek MT5881.

config MT53_FPGA
	bool "FPGA environment"
	default n

config MT53XX_UP_CHECK
	bool
	default n

config MT53XX_NATIVE_GPIO
	bool
	default n

config MT53XX_USE_CHANNELB_DRAM
	bool "Map channel B DRAM as Linux kernel memory"
	depends on ARCH_MT5396 || ARCH_MT5398 || ARCH_MT5880
	default n
	select HIGHMEM
	select ZONE_DMA
	help
	  Map unused channel B DRAM for Linux kernel usage.

config ENABLE_EXCLUSIVE_CACHE
	bool "Enable L1&L2 exclusive cache support"
	depends on CPU_V7 && CACHE_L2X0
	default n
	help
	  This feature is only supported on CA9 with PL310

endif
config TV_DRV_VFY
	bool "tv drv vfy"
```
