
store "breakpts.cmm" Break
; store "windowps.cmm" Win

res
SYS.CPU ARM1176JZ
; In General, you can use rtck to select clock automatically.
;SYS.JC rtck
SYS.JC 10.0MHz
SYS.M UP
wait 10.ms
; This is the program name that you want to load
D.S C15:0x1 %LONG 0
D.S 0x2000705c %LONG 0 0 0 0 0 0 0 0

d.load.elf ../u-boot-1.3.4/u-boot

do "breakpts.cmm"
; do "windowps.cmm"

setup.imaskhll on
setup.imaskasm on
; You need to set the path of source code, otherwise you could not
; see the source when debugging.
;y.spath ../u-boot-1.3.4
y.spath.srd ../u-boot-1.3.4/common
y.spath.srd ../u-boot-1.3.4/board/mt5392b
y.spath.srd ../u-boot-1.3.4/include
y.spath.srd ../u-boot-1.3.4/lib_arm
y.spath.srd ../u-boot-1.3.4/lib_generic
y.spath.srd ../u-boot-1.3.4/drivers

data.list
m
V %HEX
; go


